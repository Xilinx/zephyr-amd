/*
 * Copyright (c) 2025 Advanced Micro Devices, Inc. (AMD)
 *
 * SPDX-License-Identifier: Apache-2.0
 */

/ {
	loop {
		compatible = "test-gpio-basic-api";

		out-gpios = <&axi_gpio 0 0>; /* AXI-GPIO CHANNEL 0 PIN 0 */
		in-gpios = <&axi_gpio 1 0>; /* AXI-GPIO CHANNEL 0 PIN 1 */
	};
};
