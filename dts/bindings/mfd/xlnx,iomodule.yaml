## dts/bindings/mfd/xlnx,iomodule.yaml
```yaml
# Copyright (c) 2026 Advanced Micro Devices, Inc.
# SPDX-License-Identifier: Apache-2.0

description: |
  AMD/Xilinx IOModule - Multi-Function Device

  The IOModule is a composite soft IP peripheral for MicroBlaze containing:
    - Interrupt Controller (INTC) with internal + external IRQ support
    - UART (UartLite compatible)
    - 4x Programmable Interval Timers (PIT)
    - 4x Fixed Interval Timers (FIT)
    - 4x General Purpose Input/Output (GPI/GPO)

  All peripherals share a single base address and interrupt line.
  Child nodes use compatible strings "xlnx,iomodule-intc",
  "xlnx,iomodule-uart", and "xlnx,iomodule-pit".

compatible: "xlnx,iomodule"

include: [base.yaml]

properties:
  reg:
    required: true

  interrupts:
    required: true
```

## dts/bindings/serial/xlnx,iomodule-uart.yaml
```yaml
# Copyright (c) 2026 Advanced Micro Devices, Inc.
# SPDX-License-Identifier: Apache-2.0

description: |
  Xilinx IOModule UART (child of IOModule MFD)

  This is the UartLite-compatible UART block within the IOModule.
  It provides basic serial communication with TX/RX FIFOs.

  This node must be a child of an xlnx,iomodule node.

  Registers used (offsets from IOModule base):
    0x00: RX Data FIFO
    0x04: TX Data FIFO
    0x08: Status Register
    0x4C: Baud Rate Divider (optional)

compatible: "xlnx,iomodule-uart"

include: [uart-controller.yaml, base.yaml]

properties:
  current-speed:
    description: Baud rate for the UART
    default: 9600

  xlnx,uart-baudrate:
    type: int
    description: |
      Hardware-configured UART baud rate.
      This is typically set at IP synthesis time through Vivado.

  xlnx,uart-prog-baudrate:
    type: boolean
    description: |
      If present, the UART baud rate is programmable via
      the baud rate divider register at offset 0x4C.

  xlnx,uart-data-bits:
    type: int
    default: 8
    description: Number of data bits (typically 8)

  xlnx,uart-use-parity:
    type: boolean
    description: Enable parity checking

  xlnx,uart-odd-parity:
    type: boolean
    description: Use odd parity (default is even when parity enabled)
```

## dts/bindings/timer/xlnx,iomodule-pit.yaml
```yaml
# Copyright (c) 2026 Advanced Micro Devices, Inc.
# SPDX-License-Identifier: Apache-2.0

description: |
  Xilinx IOModule Programmable Interval Timer (PIT)
  (child of IOModule MFD)

  The IOModule contains up to 4 PITs. Each PIT has:
    - A preload register
    - A down-counter
    - A control register (enable, auto-reload, interrupt enable)

  PITs can be cascaded: PIT n+1 can use PIT n's output as its
  prescaler/input clock.

  This node must be a child of an xlnx,iomodule node.

compatible: "xlnx,iomodule-pit"

include: [base.yaml]

properties:
  xlnx,pit-timer-id:
    type: int
    required: true
    description: |
      Timer instance number (0-3). Determines register offset:
        PIT0: offset 0x40-0x48
        PIT1: offset 0x50-0x58
        PIT2: offset 0x60-0x68
        PIT3: offset 0x70-0x78

  xlnx,pit-size:
    type: int
    default: 32
    description: Counter width in bits (typically 32)

  xlnx,pit-readable:
    type: boolean
    description: If present, the counter register is readable

  xlnx,pit-prescaler:
    type: int
    default: 0
    description: |
      Clock prescaler value. 0 = use system clock directly.
      When non-zero, PIT n uses PIT (n-1) output as input,
      enabling cascade mode.

  xlnx,clock-freq:
    type: int
    required: true
    description: Input clock frequency in Hz
```

## samples/drivers/can/counter/sample.yaml
```yaml
sample:
  name: CAN driver counter sample
tests:
  sample.drivers.can.counter:
    tags: can
    depends_on: can
    integration_platforms:
      - native_sim
    filter: dt_chosen_enabled("zephyr,canbus") and not dt_compat_enabled("kvaser,pcican")
      and not dt_compat_enabled("infineon,xmc4xxx-can-node")
      and not dt_compat_enabled("xlnx,canfd-2.0")
    harness: console
    harness_config:
      type: one_line
      regex:
        - "Counter received: (.*)"
  sample.drivers.can.counter.xilinx_canfd:
    tags: can
    depends_on: can
    filter: dt_chosen_enabled("zephyr,canbus") and dt_compat_enabled("xlnx,canfd-2.0")
    extra_configs:
      - CONFIG_CAN_FD_MODE=y
      - CONFIG_LOOPBACK_MODE=y
    harness: console
    harness_config:
      type: one_line
      regex:
        - "Counter received: (.*)"
```

## samples/drivers/dma/dmatest/Kconfig
```kconfig
# Copyright (c) 2025 Advance Micro devices
# SPDX-License-Identifier: Apache-2.0

mainmenu "DMA TEST"

source "Kconfig.zephyr"

config DMA_TRANSFER_CHANNEL
	int "DMA channel to use"
	default 8
```

## samples/drivers/dma/dmatest/sample.yaml
```yaml
sample:
  description: DMA direct mode transfer
  name: DMA driver sample
common:
  tags: drivers
  depends_on: dma
  harness: console
  harness_config:
    type: one_line
    regex:
      - "DMA transfer verified all on channels"
tests:
  sample.drivers.dma:
    integration_platforms:
      - versalnet_rpu
      - versal2_rpu

  sample.drivers.dma.scatter_gather:
    integration_platforms:
      - versalnet_rpu
      - versal2_rpu
    extra_configs:
      - CONFIG_DMA_TEST_SG_MODE=y
```

## samples/net/dhcpv4_client/sample.yaml
```yaml
sample:
  name: DHCP Client
tests:
  sample.net.dhcpv4_client:
    depends_on: netif
    tags:
      - net
      - http
    harness: console
    harness_config:
      type: one_line
      regex:
        - "Lease time\\[\\d+\\]: \\d+ seconds"
```

## samples/net/sockets/packet/sample.yaml
```yaml
sample:
  description: Packet socket sample
  name: packet-socket
tests:
  sample.net.sockets.packet:
    platform_allow:
      - native_sim
      - native_sim/native/64
    integration_platforms:
      - native_sim
    tags:
      - net
      - sockets
      - packet-socket
    harness: console
    harness_config:
      type: multi_line
      ordered: true
      regex:
        - "Sent \\d+ bytes"
        - "Received \\d+ bytes"
```

## samples/sensor/lsm6dso_i2c_on_i3c/boards/versalnet_rpu.conf
```kconfig
CONFIG_CLOCK_CONTROL=y
CONFIG_CLOCK_CONTROL_FIXED_RATE_CLOCK=y
CONFIG_I3C_CONTROLLER_ROLE_ONLY=y
```

## soc/xlnx/mbv32/Kconfig.defconfig
```kconfig
#
# Copyright (c) 2024 Advanced Micro Devices, Inc.
#
# SPDX-License-Identifier: Apache-2.0
#

if SOC_MBV32

config MBV_CSR_DATA_WIDTH
	int "Select Control/Status register width"
	default 32

config NUM_IRQS
	default 44

config ARCH_HAS_CUSTOM_CPU_IDLE
	default y

config ARCH_HAS_CUSTOM_CPU_ATOMIC_IDLE
	default y

config SYS_CLOCK_HW_CYCLES_PER_SEC
	default $(dt_node_int_prop_int,/cpus/cpu@0,clock-frequency)

endif # SOC_MBV32
```

## soc/xlnx/mbv32/Kconfig.soc
```kconfig
#
# Copyright (c) 2024-2025 Advanced Micro Devices, Inc.
#
# SPDX-License-Identifier: Apache-2.0
#

config SOC_MBV32
	bool

config SOC
	default "mbv32" if SOC_MBV32
```

## soc/xlnx/versal2/Kconfig.defconfig
```kconfig
#
# Copyright (c) 2025 Advanced Micro Devices, Inc.
#
# SPDX-License-Identifier: Apache-2.0
#

if SOC_AMD_VERSAL2

if SOC_AMD_VERSAL2_RPU

config NUM_IRQS
	# must be >= the highest interrupt number used
	# - include the UART interrupts
	default 288

endif # SOC_AMD_VERSAL2_RPU

endif # SOC_VERSAL2_AMD
```

## tests/drivers/console/hello_world/boards/versal2_apu_amd_versal2_apu_xen_domu.conf
```kconfig
# Copyright (c) 2026, Advanced Micro Devices, Inc.
# SPDX-License-Identifier: Apache-2.0

CONFIG_UART_PL011=y
```

## tests/drivers/gpio/gpio_basic_api/testcase.yaml
```yaml
common:
  tags:
    - drivers
    - gpio
  depends_on: gpio
  harness: ztest

tests:
  drivers.gpio.2pin:
    min_flash: 34
    filter: dt_compat_enabled("test-gpio-basic-api")

  drivers.gpio.nrf_sense_edge:
    platform_allow: nrf52840dk/nrf52840 nrf52_bsim
    extra_args: "DTC_OVERLAY_FILE=boards/nrf52840dk_nrf52840.overlay;\
                 boards/nrf52840dk_nrf52840_sense_edge.overlay"

  drivers.gpio.mr_canhubk3_wkpu:
    platform_allow: mr_canhubk3
    extra_args: "DTC_OVERLAY_FILE=boards/mr_canhubk3_wkpu.overlay"

  drivers.gpio.kv260_r5:
    filter: CONFIG_GPIO_XLNX_PS
    extra_args: "DTC_OVERLAY_FILE=boards/kv260_r5.overlay"

  drivers.gpio.mbv32:
    filter: CONFIG_GPIO_XLNX_AXI
    platform_allow:
      - mbv32
    extra_args: "DTC_OVERLAY_FILE=boards/mbv32.overlay"
```

## tests/drivers/watchdog/wdt_error_cases/testcase.yaml
```yaml
common:
  tags:
    - drivers
    - watchdog
  depends_on: watchdog
  harness: ztest

tests:
  drivers.watchdog.wdt_error_cases:
    platform_allow:
      - nrf54l15pdk/nrf54l15/cpuapp
      - nrf54h20dk/nrf54h20/cpuapp
      - nrf54h20dk/nrf54h20/cpurad
    integration_platforms:
      - nrf54l15pdk/nrf54l15/cpuapp
  drivers.watchdog.wdt_error_cases.versalnet_rpu:
    filter: dt_compat_enabled("xlnx,versal-wwdt")
    platform_allow:
      - versalnet_rpu
```

## tests/subsys/sd/mmc/testcase.yaml
```yaml
common:
  depends_on: sdhc
  tags:
    - drivers
    - sdhc
tests:
  sd.mmc:
    harness: ztest
    filter: dt_alias_exists("sdhc0") and dt_compat_enabled("zephyr,mmc-disk")
    tags: sdhc
    min_ram: 32
    integration_platforms:
      - mimxrt595_evk/mimxrt595s/cm33
  sd.xlnx_sdhc.mmc:
    filter: dt_alias_exists("sdhc0") and CONFIG_XLNX_SDHC
    platform_allow:
      - versal2_rpu
      - versalnet_rpu
    extra_args: "DTC_OVERLAY_FILE=boards/versal.overlay"
```

## tests/subsys/sd/sdmmc/testcase.yaml
```yaml
common:
  depends_on: sdhc
  tags:
    - drivers
    - sdhc
tests:
  sd.sdmmc:
    harness: ztest
    filter: dt_alias_exists("sdhc0")
    tags: sdhc
    min_ram: 32
    integration_platforms:
      - mimxrt1064_evk
```

## tests/subsys/ufs/testcase.yaml
```yaml
common:
  depends_on: ufs
  tags:
    - subsys
    - ufs
tests:
  ufs.ufs_api:
    harness: ztest
    filter: dt_alias_exists("ufs0")
    tags: ufs
```
