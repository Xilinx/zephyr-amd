## drivers/entropy/Kconfig.trngpsx
```kconfig
# AMD/Xilinx TRNGPSX configuration

# Copyright (c) 2026 Advanced Micro Devices, Inc.
# SPDX-License-Identifier: Apache-2.0

config ENTROPY_AMD_TRNGPSX
	bool "AMD/Xilinx TRNGPSX HRNG entropy driver"
	default y
	depends on DT_HAS_XLNX_PMCL_TRNG_11_0_ENABLED
	select ENTROPY_HAS_DRIVER
	help
	  This option enables the entropy driver for the AMD/Xilinx TRNGPSX
	  True Random Number Generator operating in HRNG (Hybrid Random Number
	  Generator) mode.
```

## drivers/gpio/Kconfig.xlnx_iomodule
```kconfig
# Copyright 2026 Advanced Micro Devices, Inc.
#
# SPDX-License-Identifier: Apache-2.0

config GPIO_XLNX_IOMODULE
	bool "Xilinx IOModule GPIO driver"
	default y
	depends on DT_HAS_XLNX_IOMODULE_GPIO_ENABLED
	depends on MFD_XLNX_IOMODULE
	depends on GPIO
	help
	  Enable GPIO support for Xilinx IOModule GPI/GPO ports.
```

## dts/bindings/gpio/xlnx,iomodule-gpio.yaml
```yaml
# Copyright (c) 2026 Advanced Micro Devices, Inc.
# SPDX-License-Identifier: Apache-2.0

description: |
  Xilinx IOModule GPI or GPO port (child of IOModule MFD).

compatible: "xlnx,iomodule-gpio"

include: [gpio-controller.yaml, base.yaml]

properties:
  xlnx,gpio-port:
    type: int
    required: true
    enum: [1, 2, 3, 4]
    description: |
      IOModule GPIO port index (1-4), corresponding to the
      General Purpose Input (GPI) or General Purpose Output (GPO)
      instance configured in hardware.

  xlnx,gpio-direction:
    type: string
    required: true
    enum:
      - input
      - output
    description: |
      Fixed hardware direction of the port as configured in the
      IOModule IP. "input" corresponds to a GPI port and "output"
      corresponds to a GPO port. Direction cannot be changed at
      runtime.

  ngpios:
    type: int
    required: true
    description: |
      Number of GPIO signals implemented by this port, corresponding
      to the "Number of Bits" setting in the IOModule IP
      configuration.

  xlnx,gpio-init:
    type: int
    description: |
      Initial output value configured for a GPO (output) port,
      corresponding to the "Initial Value of GPO" setting in the
      IOModule IP configuration. Ignored for GPI (input) ports.

  xlnx,gpio-interrupt-type:
    type: int
    enum:
      - 0
      - 1
      - 2
      - 3
    description: |
      Fixed GPI edge-interrupt capability, as configured in Vivado. IOModule
      GPI edge detection is fixed in hardware and is not software
      configurable, so a request for an edge trigger the hardware isn't
      wired to detect must be rejected by the driver:
        0 = no interrupt capability (default)
        1 = both rising and falling edges
        2 = rising edge only
        3 = falling edge only
      Ignored for GPO (output) ports.

  "#gpio-cells":
    const: 2

gpio-cells:
  - pin
  - flags
```

## dts/bindings/rng/xlnx,pmcl-trng-11.0.yaml
```yaml
# Copyright (c) 2026 Advanced Micro Devices, Inc.
# SPDX-License-Identifier: Apache-2.0

description: |
  AMD/Xilinx TRNGPSX True Random Number Generator.

  This binding describes the TRNGPSX IP operating in HRNG (Hybrid Random
  Number Generator) mode: the ring-oscillator true-entropy source
  continuously reseeds an internal DRBG and conditioned 256-bit random
  blocks are read from the core output register. No external seed is used.

compatible: "xlnx,pmcl-trng-11.0"

include: base.yaml

properties:
  reg:
    required: true
```

## samples/drivers/rtc/sample.yaml
```yaml
sample:
  name: Real-Time Clock Sample
common:
  tags:
    - samples
    - rtc
    - api
  harness: console
  harness_config:
    type: one_line
    regex:
      - "RTC date and time: 2024-11-17 04:19:01"
tests:
  sample.drivers.rtc:
    platform_allow:
      - kv260_r5
      - stm32f3_disco
      - mimxrt700_evk/mimxrt798s/cm33_cpu0
      - mimxrt700_evk/mimxrt798s/cm33_cpu1
      - versal_apu
      - versal_rpu
      - versalnet_apu
      - versalnet_rpu
      - versal2_apu
      - versal2_rpu
    integration_platforms:
      - stm32f3_disco
    depends_on:
      - rtc
  sample.drivers.rtc.shields:
    platform_allow:
      - adafruit_qt_py_rp2040/rp2040
      - adafruit_metro_rp2040/rp2040
    integration_platforms:
      - adafruit_qt_py_rp2040/rp2040
      - adafruit_metro_rp2040/rp2040
    extra_args:
      - platform:adafruit_qt_py_rp2040/rp2040:SHIELD="sparkfun_rv8803"
      - platform:adafruit_metro_rp2040/rp2040:SHIELD="adafruit_pcf8523"
```

## tests/drivers/i2c/i2c_xilinx_axi/testcase.yaml
```yaml
# Copyright (c) 2026 Advanced Micro Devices, Inc. (AMD)
# SPDX-License-Identifier: Apache-2.0

tests:
  drivers.i2c.xilinx_axi:
    tags: drivers i2c ztest
    filter:
      dt_compat_enabled("xlnx,xps-iic-2.1") or
      dt_compat_enabled("xlnx,xps-iic-2.00.a")
```
