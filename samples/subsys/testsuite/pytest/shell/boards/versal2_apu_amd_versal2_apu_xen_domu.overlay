/*
 * Copyright (c) 2026, Advanced Micro Devices, Inc.
 *
 * SPDX-License-Identifier: Apache-2.0
 *
 * UART0 passthrough overlay for AMD Versal Gen 2 APU Xen DomU.
 *
 * Enables UART0 (f1920000) as console instead of HVC.
 * Requires Xen domain config:
 *   irqs = [57]            # SPI 25 + 32
 *   iomem = ["0xf1920,1"]
 * And U-Boot:
 *   fdt set /axi/serial@f1920000 xen,passthrough
 */

/ {
	chosen {
		zephyr,console = &uart0;
		zephyr,shell-uart = &uart0;
	};

	uart0_clk: uart0-clock {
		compatible = "fixed-clock";
		#clock-cells = <0>;
		clock-frequency = <100000000>;
	};
};

&uart0 {
	compatible = "arm,pl011";
	clocks = <&uart0_clk>;
	status = "okay";
	current-speed = <115200>;
};
