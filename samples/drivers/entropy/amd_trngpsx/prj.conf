## CMakeLists.txt
```
# SPDX-License-Identifier: Apache-2.0

cmake_minimum_required(VERSION 3.20.0)

find_package(Zephyr REQUIRED HINTS $ENV{ZEPHYR_BASE})
project(amd_trngpsx)

target_sources(app PRIVATE src/main.c)
```

## sample.yaml
```
sample:
  name: AMD/Xilinx TRNGPSX HRNG entropy
  description: Read random data from the AMD/Xilinx TRNGPSX (HRNG mode) entropy
    driver and print it.
common:
  tags:
    - entropy
    - rng
  depends_on: entropy
  harness: console
  harness_config:
    type: multi_line
    regex:
      - "entropy device ready"
      - "random bytes:"
tests:
  sample.drivers.entropy.amd_trngpsx:
    filter: dt_chosen_enabled("zephyr,entropy")
```

## prj.conf
```kconfig
CONFIG_STDOUT_CONSOLE=y
CONFIG_EARLY_CONSOLE=y
CONFIG_ENTROPY_GENERATOR=y
CONFIG_ENTROPY_AMD_TRNGPSX=y
CONFIG_HEAP_MEM_POOL_SIZE=1024
```

## src/main.c
```c
/*
 * Copyright (c) 2026 Advanced Micro Devices, Inc.
 *
 * SPDX-License-Identifier: Apache-2.0
 */

#include <zephyr/kernel.h>
#include <zephyr/device.h>
#include <zephyr/drivers/entropy.h>
#include <zephyr/sys/printk.h>

#define ENTROPY_SAMPLE_BYTES 32U

int main(void)
{
	const struct device *const dev = DEVICE_DT_GET(DT_CHOSEN(zephyr_entropy));
	uint8_t *buf;
	int ret;

	buf = k_malloc(ENTROPY_SAMPLE_BYTES);
	if (buf == NULL) {
		printk("failed to allocate entropy buffer\n");
		return 0;
	}

	if (!device_is_ready(dev)) {
		printk("entropy device not ready\n");
		k_free(buf);
		return 0;
	}

	printk("entropy device ready: %s\n", dev->name);

	ret = entropy_get_entropy(dev, buf, ENTROPY_SAMPLE_BYTES);
	if (ret < 0) {
		printk("entropy_get_entropy failed (%d)\n", ret);
		k_free(buf);
		return 0;
	}

	printk("random bytes:");
	for (size_t i = 0; i < ENTROPY_SAMPLE_BYTES; i++) {
		printk(" %02x", buf[i]);
	}
	printk("\ndone\n");

	k_free(buf);

	return 0;
}
```
