// SPDX-License-Identifier: GPL-2.0
/*
 * (C) Copyright 2025, Advanced Micro Devices, Inc.
 *
 * Srikanth Boyapally <srikanth.boyapally@amd.com>
 */

#include "versalnet_rpu.dts"
/delete-node/ &spi0;

&spi1 {
	status = "okay";
	cdns,num-ss-bits = <3>;
	is-decoded-cs = <0>;
	clocks = <&spi_ref_clk>;
	flash@2 {
		compatible = "jedec,spi-nor";
		reg = <2>;
		spi-max-frequency = <8000000>;
		jedec-id = [ c2 25 36 ]; /* mx25u3235f */
		size = <0x2000000>; /* 32Mb */
		has-dpd;
		t-enter-dpd = <10000>;
		t-exit-dpd = <35000>;
	};
};
