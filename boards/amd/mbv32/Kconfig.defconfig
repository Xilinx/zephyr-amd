## boards/amd/mbv32/Kconfig.defconfig
```kconfig
#
# Copyright (c) 2024 - 2025 Advanced Micro Devices, Inc.
#
# SPDX-License-Identifier: Apache-2.0
#

if BOARD_MBV32
config RISCV_ISA_RV32I
	default y

config RISCV_ISA_EXT_M
	default y

config RISCV_ISA_EXT_A
	default y

config RISCV_ISA_EXT_C
	default y

config RISCV_ISA_EXT_ZICSR
	default y

config RISCV_ISA_EXT_ZIFENCEI
	default y
endif
```

## boards/amd/mbv32/Kconfig.kcu105_mbv32
```kconfig
#
# Copyright (c) 2024 - 2025 Advanced Micro Devices, Inc.
#
# SPDX-License-Identifier: Apache-2.0
#

config BOARD_KCU105_MBV32
	select SOC_MBV32

if BOARD_KCU105_MBV32
config RISCV_ISA_RV32I
	default y

config RISCV_ISA_EXT_M
	default y

config RISCV_ISA_EXT_A
	default y

config RISCV_ISA_EXT_C
	default y

config RISCV_ISA_EXT_ZICSR
	default y

config RISCV_ISA_EXT_ZIFENCEI
	default y

config MULTI_LEVEL_INTERRUPTS
	default y

config 2ND_LEVEL_INTERRUPTS
	default y

config 2ND_LVL_INTR_00_OFFSET
	default 11

config 2ND_LVL_ISR_TBL_OFFSET
	default 12

config MAX_IRQ_PER_AGGREGATOR
	default 32

endif
```

## boards/amd/mbv32/board.yml
```yaml
boards:
  - name: mbv32
    vendor: amd
    socs:
    - name: mbv32

  - name: kcu105_mbv32
    vendor: amd
    socs:
    - name: mbv32
```

## boards/amd/mbv32/mbv32_defconfig
```kconfig
#
# Copyright (c) 2024 Advanced Micro Devices, Inc.
#
# SPDX-License-Identifier: Apache-2.0
#

CONFIG_XIP=n
CONFIG_HEAP_MEM_POOL_SIZE=4096
```

## boards/amd/versal2_apu/versal2_apu_amd_versal2_apu_xen_domu_defconfig
```kconfig
# Xen DomU does not use TF-A; Xen loads the guest directly
CONFIG_BUILD_WITH_TFA=n
CONFIG_BUILD_OUTPUT_BIN=y

CONFIG_ARM64_VA_BITS_40=y
CONFIG_ARM64_PA_BITS_40=y
CONFIG_TIMER_READS_ITS_FREQUENCY_AT_RUNTIME=y

CONFIG_ARMV8_A_NS=y

CONFIG_SERIAL=y
CONFIG_CONSOLE=y
CONFIG_UART_CONSOLE=y

CONFIG_LOG=y
CONFIG_HEAP_MEM_POOL_SIZE=16384
CONFIG_MAX_XLAT_TABLES=24
```

## boards/amd/versal2_rpu/versal2_rpu_defconfig
```kconfig
# Enable UART driver
CONFIG_SERIAL=y

# Enable console
CONFIG_CONSOLE=y
CONFIG_UART_CONSOLE=y

# Enable serial port
CONFIG_UART_PL011=y

# Enable cache and arch timer
CONFIG_CACHE_MANAGEMENT=y
CONFIG_ARM_ARCH_TIMER=y

# Heap Memory
CONFIG_HEAP_MEM_POOL_SIZE=16384

# Prevent GIC re-initialization in AMP configurations
CONFIG_GIC_SAFE_CONFIG=y
```

## boards/amd/versal_apu/versal_apu_defconfig
```kconfig
# The Zephyr build from this defconfig is expected to boot from
# Xilinx Arm Trusted Firmware (ATF).
# Boot Flow is: Boot PDI -> TF-A -> Zephyr

CONFIG_BUILD_WITH_TFA=y

CONFIG_ARM64_VA_BITS_40=y
CONFIG_ARM64_PA_BITS_40=y
CONFIG_TIMER_READS_ITS_FREQUENCY_AT_RUNTIME=y

# Enable UART driver
CONFIG_SERIAL=y

# Enable console
CONFIG_CONSOLE=y
CONFIG_UART_CONSOLE=y

# Enable serial port
CONFIG_UART_PL011=y

# FIXME: QEMU testing runs at EL1 Secure due to TF-A limitation requiring PLM.
# Upstream fix: https://review.trustedfirmware.org/c/TF-A/trusted-firmware-a/+/46458
# Once merged, uncomment below to enable EL1 Non-Secure mode:
#CONFIG_ARMV8_A_NS=y
```

## boards/amd/versalnet_rpu/Kconfig.vn_p_b2197_x_prc_07_rpu
```kconfig
#
# Copyright (c) 2025 Advanced Micro Devices, Inc.
#
# SPDX-License-Identifier: Apache-2.0
#

config BOARD_VN_P_B2197_X_PRC_07_RPU
	select SOC_AMD_VERSALNET_RPU
```

## boards/amd/versalnet_rpu/board.yml
```yaml
boards:
  - name: versalnet_rpu
    vendor: amd
    socs:
      - name: amd_versalnet_rpu

  - name: vn_p_b2197_x_prc_07_rpu
    vendor: amd
    socs:
      - name: amd_versalnet_rpu

  - name: vn_p_b2197_x_prc_09_rpu
    vendor: amd
    socs:
      - name: amd_versalnet_rpu
```

## boards/amd/versalnet_rpu/tenzing2_se9_rpu_defconfig
```kconfig
CONFIG_ISR_STACK_SIZE=1024
CONFIG_THREAD_STACK_INFO=y

# Enable UART driver
CONFIG_SERIAL=y

# Enable console
CONFIG_CONSOLE=y
CONFIG_UART_CONSOLE=y

# Enable serial port
CONFIG_UART_PL011=y

# Enable I2C, EEPROM
CONFIG_I2C=y
CONFIG_EEPROM=y

CONFIG_ARM_ARCH_TIMER=y

CONFIG_ARM_MPU=y
CONFIG_CACHE_MANAGEMENT=y
CONFIG_SYS_CLOCK_HW_CYCLES_PER_SEC=100000000
```

## boards/amd/versalnet_rpu/versalnet_rpu_defconfig
```kconfig
# Enable UART driver
CONFIG_SERIAL=y

# Enable console
CONFIG_CONSOLE=y
CONFIG_UART_CONSOLE=y

# Enable serial port
CONFIG_UART_PL011=y

# Enable I2C, EEPROM
CONFIG_I2C=y
CONFIG_EEPROM=y

# Prevent GIC re-initialization in AMP configurations
CONFIG_GIC_SAFE_CONFIG=y
```

## boards/amd/versalnet_rpu/vn_p_b2197_x_prc_07_rpu_defconfig
```kconfig
CONFIG_ISR_STACK_SIZE=1024
CONFIG_THREAD_STACK_INFO=y

# Enable UART driver
CONFIG_SERIAL=y

# Enable console
CONFIG_CONSOLE=y
CONFIG_UART_CONSOLE=y

# Enable serial port
CONFIG_UART_PL011=y

# Enable SPI, FLASH
CONFIG_FLASH=y
CONFIG_SPI=y

CONFIG_ARM_ARCH_TIMER=y

CONFIG_ARM_MPU=y
CONFIG_CACHE_MANAGEMENT=y
```

## drivers/dma/Kconfig.xilinx_adma
```kconfig
# ADMA Driver configuration options
# Copyright (c) 2025 Advanced Micro Devices.

# SPDX-License-Identifier: Apache-2.0


config DMA_XILINX_ADMA
	bool "Using Xilinx ADMA driver"
	default y
	depends on DT_HAS_XLNX_ZYNQMP_DMA_1_0_ENABLED || DT_HAS_AMD_VERSAL2_DMA_1_0_ENABLED
	select CACHE_MANAGEMENT
	select EVENTS
	help
	  DMA driver for Xilinx ADMA.

config DMA_XILINX_ADMA_BURST
	int "Maximum Burst supported"
	default 16
```

## drivers/ethernet/Kconfig.xilinx_axienet
```kconfig
#
# Xilinx AXI 1G / 2.5G Ethernet Subsystem
#
# Copyright (c) 2024, CISPA Helmholtz Center for Information Security
# SPDX-License-Identifier: Apache-2.0
#

config ETH_XILINX_AXIENET
	bool "Xilinx AXI Ethernet Driver"
	default y
	depends on DT_HAS_XLNX_AXI_ETHERNET_1_00_A_ENABLED
	depends on DT_HAS_XLNX_ETH_DMA_ENABLED
	select DMA
	select MDIO if DT_HAS_XLNX_AXI_ETHERNET_1_00_A_MDIO_ENABLED
	help
		Enable Xilinx 1G / 2.5G AXI Ethernet driver,
		commonly found on FPGAs.
```

## drivers/flash/Kconfig.cadence_ospi_nor
```kconfig
# Copyright (c) 2025 Advanced Micro Devices, Inc.
# SPDX-License-Identifier: Apache-2.0

config FLASH_CAD_OSPI_NOR
	bool "Cadence Octal SPI Flash driver"
	default y
	depends on DT_HAS_XLNX_VERSAL_OSPI_1_0_ENABLED
	select FLASH_HAS_PAGE_LAYOUT
	select FLASH_HAS_DRIVER_ENABLED
	select FLASH_HAS_EXPLICIT_ERASE
	help
	  Enable Cadence OSPI-NOR support.

if FLASH_CAD_OSPI_NOR

config CAD_QSPI_MICRON_MT35X_SUPPORT
	bool "Cadence Octal SPI Micron MT35X Support"
	default y
	help
	  Enable Micron MT35X Support.

config QSPI_LAYOUT_PAGE_SIZE
	int "Page size to use for FLASH_LAYOUT feature"
	default 65536
	help
	  When CONFIG_FLASH_PAGE_LAYOUT is used this driver will support that API.
	  By default the page size corresponds to the sector size (4096) for a NOR
	  flash memory. Other options may include the 32K-byte erase size (32768),
	  the block size (65536), or any non-zero multiple of the sector size.

config CAD_QSPI_NOR_SECTOR_SIZE
	hex "Cadence Quad SPI sector size"
	default 0x10000
	help
	Set the Cadence Quad SPI sector size.

config QSPI_ADDR_BYTES
	int "Access QSPI address memory size in bytes"
	default 2
	help
	  Set the address memory size in bytes when
	  accessing QSPI.

config QSPI_BYTES_PER_DEV
	int "Set QSPI to read / write how many bytes per device"
	default 256
	help
	  Set the size for a QSPI to read / write per device.

config QSPI_BYTES_PER_BLOCK
	int "Set QSPI to read / write how many bytes per block"
	default 16
	help
	  Set the size for a QSPI to read / write per block.

endif # FLASH_CAD_OSPI_NOR
```

## drivers/interrupt_controller/Kconfig.xlnx_iomodule
```kconfig
# Copyright (c) 2026 Advanced Micro Devices, Inc.
# SPDX-License-Identifier: Apache-2.0

config XLNX_IOMODULE_INTC
	bool "Xilinx IOModule Interrupt Controller"
	default y
	depends on DT_HAS_XLNX_IOMODULE_INTC_ENABLED
	depends on MFD_XLNX_IOMODULE
	help
	  Enable the interrupt controller within the Xilinx IOModule.
	  This is a child driver of the IOModule MFD and provides the same
	  xlnx_intc_irq_*() API as the AXI INTC driver.

	  The IOModule INTC handles both internal peripheral interrupts
	  (UART, PIT, FIT, GPI) and up to 16 external interrupt inputs.

	  This is mutually exclusive with the AXI INTC driver (XLNX_INTC).
```

## drivers/mfd/Kconfig.xlnx_iomodule
```kconfig
# Copyright (c) 2026 Advanced Micro Devices, Inc.
# SPDX-License-Identifier: Apache-2.0

config MFD_XLNX_IOMODULE
	bool "Xilinx IOModule MFD driver"
	default y
	depends on DT_HAS_XLNX_IOMODULE_ENABLED
	help
	  Enable the Xilinx IOModule Multi-Function Device driver.
	  The IOModule is a composite soft IP peripheral containing:
	  - Interrupt Controller (INTC)
	  - UART (UartLite compatible)
	  - Programmable Interval Timers (PIT)
	  - Fixed Interval Timers (FIT)
	  - General Purpose I/O (GPI/GPO)

	  This parent driver manages the shared base address and IRQ line,
	  dispatching interrupts to child peripheral drivers.

config MFD_XLNX_IOMODULE_INIT_PRIORITY
	int "IOModule MFD parent initialization priority"
	default 49
	depends on MFD_XLNX_IOMODULE
	help
	  Initialization priority for the IOModule MFD parent driver.
	  Must be lower (earlier) than SERIAL_INIT_PRIORITY (default 50)
	  so the parent is ready before the UART child initializes, and
	  the UART is ready before CONSOLE_INIT_PRIORITY (default 60).

config MFD_XLNX_IOMODULE_CHILD_INIT_PRIORITY
	int "IOModule non-UART child driver initialization priority"
	default 51
	depends on MFD_XLNX_IOMODULE
	help
	  Initialization priority for IOModule child drivers (INTC, PIT).
	  Must be higher (later) than MFD_XLNX_IOMODULE_INIT_PRIORITY
	  so the parent device is ready before children initialize.
	  The UART child uses SERIAL_INIT_PRIORITY (default 50) instead.
```

## drivers/timer/Kconfig.xlnx_iomodule_pit
```kconfig
# Copyright (c) 2026 Advanced Micro Devices, Inc.
# SPDX-License-Identifier: Apache-2.0

config XLNX_IOMODULE_PIT
	bool "Xilinx IOModule PIT Timer"
	default y
	depends on DT_HAS_XLNX_IOMODULE_PIT_ENABLED
	depends on MFD_XLNX_IOMODULE
	help
	  Enable the Programmable Interval Timer (PIT) within the Xilinx
	  IOModule. The IOModule contains up to 4 PITs that can be used
	  as system timers. Each PIT is a simple down-counter with
	  auto-reload capability.

	  This is a child driver of the IOModule MFD.

if XLNX_IOMODULE_PIT

module = XLNX_IOMODULE_PIT
module-str = xlnx-iomodule-pit
source "subsys/logging/Kconfig.template.log_config"

endif # XLNX_IOMODULE_PIT
```

## dts/bindings/counter/xlnx,ttc-counter.yaml
```yaml
# Copyright (c) 2026 Advanced Micro Devices, Inc.
#
# SPDX-License-Identifier: Apache-2.0

description: |
  Xilinx TTC (Triple Timer Counter) individual counter device.

  Each TTC IP block contains 3 independent counters. This binding represents
  a single counter within a TTC block. Multiple counters from the same TTC
  block share the same base address (reg) but have different timer-id values.

compatible: "xlnx,ttc-counter"

include: [base.yaml]

properties:
  reg:
    required: true
    description: |
      Base address of the TTC block. Multiple counters within the same
      TTC block share this address and are differentiated by timer-id.

  interrupts:
    required: true
    description: |
      Timer interrupt configuration. Each counter within a TTC block
      typically has its own interrupt line.

  timer-id:
    type: int
    required: true
    enum:
      - 0
      - 1
      - 2
    description: |
      Counter index within the TTC block (0, 1, or 2).
      Each TTC IP block has exactly 3 counters.

  prescaler:
    type: int
    description: |
      Clock prescaler value (0-15). The effective frequency is:
      freq = clock-frequency / (2 ^ (prescaler + 1))

  clock-frequency:
    type: int
    required: true
    description: Input clock frequency in Hz

  timer-width:
    type: int
    required: true
    enum:
      - 16
      - 32
    description: |
      Number of bits in the timer counter.

examples:
  - |
    soc {
      #address-cells = <1>;
      #size-cells = <1>;
      /* Example for 2 TTC blocks with selected counters enabled */
      /* TTC0 - base address 0xff110000 */
      ttc0_cnt0: counter@ff110000 {
          compatible = "xlnx,ttc-counter";
          reg = <0xff110000 0x1000>;
          interrupts = <GIC_SPI 36 IRQ_TYPE_LEVEL_HIGH>;
          timer-id = <0>;
          clock-frequency = <100000000>;
          timer-width = <32>;
      };

      ttc0_cnt1: counter@ff110000 {
        compatible = "xlnx,ttc-counter";
        reg = <0xff110000 0x1000>;
        interrupts = <GIC_SPI 37 IRQ_TYPE_LEVEL_HIGH>;
        timer-id = <1>;
        clock-frequency = <100000000>;
        timer-width = <32>;
      };

      ttc0_cnt2: counter@ff110000 {
        compatible = "xlnx,ttc-counter";
        reg = <0xff110000 0x1000>;
        interrupts = <GIC_SPI 38 IRQ_TYPE_LEVEL_HIGH>;
        timer-id = <2>;
        clock-frequency = <100000000>;
        timer-width = <32>;
      };
      /* TTC1 - different base address 0xff120000 */
      ttc1_cnt0: counter@ff120000 {
        compatible = "xlnx,ttc-counter";
        reg = <0xff120000 0x1000>;
        interrupts = <GIC_SPI 39 IRQ_TYPE_LEVEL_HIGH>;
        timer-id = <0>;
        clock-frequency = <100000000>;
        timer-width = <32>;
      };
    };
```

## dts/bindings/cpu/amd,mbv32.yaml
```yaml
#
# Copyright (c) 2025 Advanced Micro Devices, Inc.
#
# SPDX-License-Identifier: Apache-2.0
#

description: AMD MICROBLAZE RISC-V Softcore Processor

compatible: "amd,mbv32"

include: riscv,cpus.yaml
```

## dts/bindings/dma/xlnx,adma-v2.yaml
```yaml
#
#  Copyright (c) 2025 Advanced Micro Devices.
#
#  SPDX-License-Identifier: Apache-2.0

description: XILINX ADMA

compatible: "amd,versal2-dma"

include: xlnx,adma.yaml
```

## dts/bindings/flash_controller/xlnx,versal-ospi-1.0.yaml
```yaml
# Copyright (c) 2025 Advanced Micro Devices, Inc.
# SPDX-License-Identifier: Apache-2.0

description: Cadence Quad-SPI NOR flash controller

compatible: "xlnx,versal-ospi-1.0"

include: cdns,qspi-nor.yaml

properties:
  size:
    type: int
    description: flash capacity in bits

  cdns,fifo-depth:
    type: int
    description: Size of the data FIFO in words.

  cdns,fifo-width:
    type: int
    description: Bus width of the data FIFO in bytes.

  cdns,tslch-ns:
    type: int
    description: Delay in nanoseconds between setting qspi_n_ss_out low and
                 first bit transfer.

  cdns,tchsh-ns:
    type: int
    description: Delay in nanoseconds between last bit of current transaction and
                 deasserting the device chip select (qspi_n_ss_out).

  cdns,tsd2d-ns:
    type: int
    description: Delay in nanoseconds between one chip select being de-activated
                 and the activation of another.

  cdns,tshsl-ns:
    type: int
    description: Delay in nanoseconds for the length that the master mode chip select
                 outputs are de-asserted between transactions.

  cdns,read-delay:
    type: int
    description: Delay for read capture logic, in clock cycles.
```
